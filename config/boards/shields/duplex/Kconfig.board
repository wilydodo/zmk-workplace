## config/boards/shields/duplex/Kconfig.board
```kconfig
config BOARD_MY_KEYBOARD
    bool "my_keyboard"
    depends on SOC_NRF52840_QIAA
```

## config/boards/shields/duplex/duplex.defconfig
```kconfig
CONFIG_SOC_SERIES_NRF52X=y
CONFIG_SOC_NRF52840_QIAA=y
CONFIG_BOARD_MY_KEYBOARD=y

# 블루투스 및 키보드 기능 활성화
CONFIG_ZMK=y
CONFIG_BT=y
CONFIG_USB=y
CONFIG_ZMK_BLE=y
```
